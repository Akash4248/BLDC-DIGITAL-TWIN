/********************************************************************************
 * Arduino UNO #2 (HIL PWM to Serial Bridge)
 * 
 * This sketch runs on the 2nd Arduino UNO. It reads the physical 5V PWM 
 * gate signals generated by the FOC Controller (Arduino #1).
 * 
 * It continuously calculates the duty cycle and sends a fast binary 
 * packet to the ESP32 (Digital Twin) over UART at 115200 baud.
 * 
 * Inputs (From Arduino #1):
 *   D3  = UH (Phase A High)
 *   D6  = VH (Phase B High)
 *   D10 = WH (Phase C High)
 *   (Low side pins 5, 9, 11 are complementary and safely ignored for simulation)
 * 
 * Output (To ESP32):
 *   TX -> ESP32 RX2 (GPIO 16)
 *   *NOTE: Since Arduino TX is 5V and ESP32 RX is 3.3V, use a simple 
 *    voltage divider (e.g. 2k & 3.3k ohms) or a logic level shifter!
 ********************************************************************************/

#include <Arduino.h>

#define PIN_UH 3
#define PIN_VH 6
#define PIN_WH 10

void setup() {
  pinMode(PIN_UH, INPUT);
  pinMode(PIN_VH, INPUT);
  pinMode(PIN_WH, INPUT);
  
  // Set up UART communication to the ESP32
  Serial.begin(115200);
}

void loop() {
  uint16_t samples = 0;
  uint16_t countA = 0;
  uint16_t countB = 0;
  uint16_t countC = 0;
  
  unsigned long start = micros();
  
  // Sample the pins extremely fast for 1 millisecond.
  // This easily captures multiple full periods of a 7.8 kHz PWM without requiring interrupts.
  while (micros() - start < 1000) {
    // Read directly from the AVR ports for maximum speed
    uint8_t pd = PIND;
    uint8_t pb = PINB;
    
    // Check if the specific pins are HIGH
    if (pd & _BV(3)) countA++; // Pin 3 (UH)
    if (pd & _BV(6)) countB++; // Pin 6 (VH)
    if (pb & _BV(2)) countC++; // Pin 10 (WH)
    
    samples++;
  }
  
  // Prevent division by zero
  if (samples == 0) samples = 1;
  
  // Calculate Duty Cycle (Scaled to 0-255)
  uint8_t dutyA = (countA * 255UL) / samples;
  uint8_t dutyB = (countB * 255UL) / samples;
  uint8_t dutyC = (countC * 255UL) / samples;
  
  // Simple checksum: Sum of duties
  uint8_t checksum = dutyA + dutyB + dutyC;
  
  // Create 6-byte binary packet for the ESP32
  // [0xAA, 0x55, DutyA, DutyB, DutyC, Checksum]
  uint8_t packet[6] = {0xAA, 0x55, dutyA, dutyB, dutyC, checksum};
  
  // Fire off the packet
  Serial.write(packet, 6);
}
